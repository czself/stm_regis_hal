#include "stm32f1xx.h"

/*
 * ============================================================================
 * 寄存器版 IWDG（独立看门狗）实验
 * ============================================================================
 *
 * ██████  本课核心知识点 ██████
 *
 * 1. IWDG（Independent Watchdog，独立看门狗）
 *    - 本质是一个硬件递减计数器，倒计时到 0 时强制复位 MCU
 *    - 程序必须在超时前"喂狗"（重装计数器），否则系统被复位
 *    - 用于检测程序是否跑飞或卡死
 *
 * 2. "独立"的含义
 *    - IWDG 使用独立时钟 LSI（约 40kHz），不依赖 APB 外设时钟
 *    - 即使主时钟（HSE/PLL）出问题，IWDG 仍然可以工作并复位系统
 *    - 这比用普通定时器实现看门狗可靠得多
 *
 * 3. 关键寄存器说明
 *    - KR（Key Register，键寄存器）：通过写入特定值触发不同操作
 *      · 0x5555：解锁 PR 和 RLR 的写保护
 *      · 0xAAAA：重装计数器（喂狗）
 *      · 0xCCCC：启动 IWDG
 *    - PR（Prescaler Register）：预分频，决定 LSI 先被分频多少
 *    - RLR（Reload Register）：重装值，决定计数器从多少开始倒数
 *    - SR（Status Register）：状态寄存器，显示 PR/RLR 更新是否完成
 *
 * 4. IWDG 的重要特性
 *    - 一旦启动，软件无法停止 IWDG！（除非硬件复位）
 *    - 所以必须有明确的喂狗策略
 *    - 配置 PR 和 RLR 之前必须先写 KR=0x5555 解锁
 *
 * 5. LSI（Low Speed Internal，内部低速振荡器）
 *    - 典型频率约 40kHz
 *    - 精度不高（误差可达 ±40%），所以超时时间只能估算
 *    - 但胜在独立性和可靠性
 *
 * ██████  Demo 演示现象 ██████
 *
 * - 上电后，程序检测上一次复位是否是 IWDG 引起的
 *   如果是：LED 快速闪 3 次（提示：上次是看门狗复位）
 * - 按住 PA0（按键接地）：程序每 300ms 喂一次狗，系统正常运行，LED 闪烁
 * - 松开 PA0：停止喂狗，IWDG 倒数到 0
 *   约 2 秒后 MCU 被强制复位，LED 闪烁重新开始
 * - 复位后再次看到 3 次快闪 → 证明是 IWDG 导致的重启
 */

static void delay_busy(volatile uint32_t n)
{
    /*
     * volatile：防止编译器优化掉这个空循环
     * __NOP()：一条汇编空指令，消耗 1 个 CPU 周期
     */
    while (n-- > 0U) {
        __NOP();
    }
}

/*---------------------------------------------------------------------------*
 * PC13 板载 LED 初始化
 *---------------------------------------------------------------------------*/
static void led_init(void)
{
    RCC->APB2ENR |= RCC_APB2ENR_IOPCEN;                    /* 打开 GPIOC 时钟 */
    GPIOC->CRH &= ~(GPIO_CRH_MODE13 | GPIO_CRH_CNF13);     /* 清除旧配置 */
    GPIOC->CRH |= GPIO_CRH_MODE13_1;                        /* 输出模式，2MHz */
    GPIOC->BSRR = GPIO_BSRR_BS13;                           /* 初始：LED 灭 */
}

/*---------------------------------------------------------------------------*
 * PA0 按键初始化
 *---------------------------------------------------------------------------*/
static void key_init(void)
{
    RCC->APB2ENR |= RCC_APB2ENR_IOPAEN;                    /* 打开 GPIOA 时钟 */
    GPIOA->CRL &= ~(GPIO_CRL_MODE0 | GPIO_CRL_CNF0);       /* 清除旧配置 */
    GPIOA->CRL |= GPIO_CRL_CNF0_1;                          /* CNF0=10：上拉/下拉输入 */
    GPIOA->BSRR = GPIO_BSRR_BS0;                            /* ODR0=1：选择内部上拉 */
}

/*---------------------------------------------------------------------------*
 * 检测按键是否被按下
 * 返回值：0=未按下，1=按下
 *---------------------------------------------------------------------------*/
static uint8_t key_pressed(void)
{
    /*
     * 按键接 GND，内部上拉，按下时 PA0 被拉到 GND
     * 所以 IDR0=0 表示按键按下
     */
    return (GPIOA->IDR & GPIO_IDR_IDR0) == 0U;
}

/*---------------------------------------------------------------------------*
 * LED 闪烁函数
 *---------------------------------------------------------------------------*/
static void led_blink(uint32_t times)
{
    for (uint32_t i = 0; i < times; i++) {
        GPIOC->BRR = GPIO_BRR_BR13;       /* LED 亮 */
        delay_busy(700000U);
        GPIOC->BSRR = GPIO_BSRR_BS13;     /* LED 灭 */
        delay_busy(700000U);
    }
}

/*---------------------------------------------------------------------------*
 * IWDG 初始化：配置约 2 秒超时
 *---------------------------------------------------------------------------*/
static void iwdg_init_approx_2s(void)
{
    /*
     * ██ 第一步：解锁 PR 和 RLR 的写保护 ██
     *
     * IWDG 的 PR 和 RLR 寄存器默认是写保护的，
     * 必须先向 KR 写入 0x5555 才能修改它们。
     * 这是为了防止程序意外修改看门狗配置。
     *
     * 就像用一把"钥匙"打开一个"锁"：
     * KR = 0x5555 → 开锁 → 可以修改 PR 和 RLR
     */
    IWDG->KR = 0x5555U;

    /*
     * ██ 第二步：配置预分频和重装值 ██
     *
     * PR 预分频设置：
     *   IWDG_PR_PR_0 = 位 0 置 1
     *   IWDG_PR_PR_1 = 位 1 置 1
     *   组合值 = 0x03 → 对应表中 4 位分频的 bit[2:0] = 011
     *
     * 查阅参考手册，PR=011 表示预分频系数 = 32
     *
     * 超时时间估算：
     *   LSI 约 40kHz（实际可能有较大误差）
     *   预分频 32 → IWDG 计数时钟 ≈ 40kHz / 32 = 1250Hz
     *   RLR = 2500 → 计数器从 2500 递减到 0
     *   超时时间 ≈ 2500 / 1250 = 2 秒
     *
     * 注意：由于 LSI 精度不高，实际超时可能是 1.2 秒到 3 秒不等
     * 这是正常现象，不是故障。
     */
    IWDG->PR = IWDG_PR_PR_0 | IWDG_PR_PR_1;
    IWDG->RLR = 2500U;

    /*
     * ██ 第三步：等待 PR 和 RLR 更新完成 ██
     *
     * 写 PR 和 RLR 后，IWDG 内部需要一段时间来完成同步。
     * SR.PVU（Prescaler Value Update）和 SR.RVU（Reload Value Update）
     * 分别表示预分频值和重装值是否正在更新中。
     * 必须等待这两个位清零，才能进行后续操作。
     *
     * 等待时 IWDG 尚未启动，所以不会触发复位。
     */
    while ((IWDG->SR & (IWDG_SR_PVU | IWDG_SR_RVU)) != 0U) {
    }

    /*
     * ██ 第四步：先喂一次狗 ██
     *
     * KR = 0xAAAA 可以随时执行，它重装计数器到 RLR 的值。
     * 在启动前先喂一次，确保计数器从 RLR 的完整值开始递减。
     * 注意：写 0xAAAA 前不需要解锁 PR/RLR，KR 对于 0xAAAA 和 0xCCCC 始终可写。
     */
    IWDG->KR = 0xAAAAU;

    /*
     * ██ 第五步：启动 IWDG ██
     *
     * KR = 0xCCCC 启动 IWDG。
     * ⚠ 重要：IWDG 一旦启动，软件不能关闭！
     * 唯一的停止方式是 MCU 复位（包括 IWDG 自身产生的复位）。
     * 所以在确认喂狗策略之前，不要轻易启动 IWDG。
     */
    IWDG->KR = 0xCCCCU;
}

/*---------------------------------------------------------------------------*
 * 主函数
 *---------------------------------------------------------------------------*/
int main(void)
{
    /*
     * ██ 检测复位来源 ██
     *
     * RCC->CSR（Control Status Register）中的 IWDGRSTF 位
     * 记录上一次复位是否由 IWDG 引起：
     * - 读 CSR.IWDGRSTF：如果为 1，表示上一次是 IWDG 复位
     * - 写 CSR.RMVF：清除所有复位标志
     *
     * 为什么需要清除 RMVF？
     *   复位标志不会自动清除。如果不手动清除，
     *   下次正常上电时读到的仍是旧标志，造成误判。
     *
     * 注意：RCC->CSR 需要在 APB2 时钟使能后才能访问，
     * 但 RCC 外设的时钟默认就是使能的，所以可以直接读。
     */
    uint8_t was_iwdg_reset = (RCC->CSR & RCC_CSR_IWDGRSTF) != 0U;
    RCC->CSR |= RCC_CSR_RMVF;  /* 清除复位标志 */

    led_init();
    key_init();

    /*
     * 如果检测到上一次是 IWDG 复位，LED 快闪 3 次
     * 这个提示可以帮助你确认看门狗确实工作了
     */
    if (was_iwdg_reset) {
        led_blink(3U);
    }

    /*
     * 配置并启动 IWDG
     * 在这之后，必须在约 2 秒内喂一次狗，否则 MCU 会被复位
     */
    iwdg_init_approx_2s();

    while (1) {
        /*
         * 主循环策略：
         * - 按键按下（PA0=GND）→ 喂狗 → LED 闪 1 次
         * - 按键松开 → 不喂狗 → LED 常亮 → 等待复位
         *
         * 主循环每次耗时约 delay_busy(1500000U)，
         * 大约几百毫秒，远小于 IWDG 的 2 秒超时。
         *
         * 所以只要按下按键走喂狗分支，系统就永远不会复位。
         * 松开按键后不喂狗，2 秒内 IWDG 就会复位 MCU。
         */
        if (key_pressed()) {
            /*
             * 喂狗：向 KR 写入 0xAAAA
             * 计数器被重新设置为 RLR 的值（2500）
             * 然后从 2500 开始重新递减
             *
             * 这步必须在 IWDG 超时前被执行，否则系统复位
             */
            IWDG->KR = 0xAAAAU;
            led_blink(1U);  /* 喂狗成功后 LED 闪 1 次表示确认 */
        } else {
            /*
             * 按键未按下：不做任何事
             * 此时不会喂狗，IWDG 计数器持续递减
             * 约 2 秒后倒数到 0 → IWDG 复位 MCU
             *
             * 为了让你看清"快复位了"的状态，让 LED 常亮
             */
            GPIOC->BRR = GPIO_BRR_BR13;  /* LED 亮 */
        }
        delay_busy(1500000U);  /* 主循环延时，控制闪烁节奏 */
    }
}